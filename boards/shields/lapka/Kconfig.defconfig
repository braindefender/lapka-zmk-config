## boards/shields/lapka/Kconfig.defconfig
```kconfig
if SHIELD_LAPKA_LEFT

config ZMK_KEYBOARD_NAME
    default "Lapka"

config ZMK_USB
    default y

config ZMK_SPLIT_ROLE_CENTRAL
    default y

config ZMK_SPLIT_BLE_CENTRAL_PERIPHERALS
    default 1

config BT_MAX_CONN
    default 7

config BT_MAX_PAIRED
    default 7

endif # SHIELD_LAPKA_LEFT

if SHIELD_LAPKA_LEFT || SHIELD_LAPKA_RIGHT

config ZMK_SPLIT
    default y

config ZMK_SPLIT_BLE
    default y

endif # SHIELD_LAPKA_LEFT || SHIELD_LAPKA_RIGHT
```
